## CMakeLists.txt
```
cmake_minimum_required(VERSION 3.20.0)
find_package(Zephyr REQUIRED HINTS $ENV{ZEPHYR_BASE})

project(ZRID_Lite_Logging)

target_sources(app PRIVATE src/main.c)
```

## prj.conf
```kconfig
### Configs needed for default BM840 ###
# Use internal clock
CONFIG_CLOCK_CONTROL_NRF_K32SRC_XTAL=n 
CONFIG_CLOCK_CONTROL_NRF_K32SRC_RC=y
CONFIG_CLOCK_CONTROL_NRF_K32SRC_RC_CALIBRATION=y

# Use DCDC converter
CONFIG_BOARD_ENABLE_DCDC=y





CONFIG_GPIO=y
CONFIG_LOG=y

CONFIG_LOG_BACKEND_SHOW_COLOR=y

# choose RTT console
CONFIG_USE_SEGGER_RTT=y
CONFIG_RTT_CONSOLE=y

# CONFIG_LOG_BACKEND_UART=y
CONFIG_LOG_BACKEND_RTT=y
```

## src/main.c
```c
#include <zephyr/kernel.h>
#include <zephyr/device.h>
#include <zephyr/devicetree.h>
#include <zephyr/drivers/gpio.h>
#include <zephyr/sys/printk.h>
#include <zephyr/logging/log.h>

#define SLEEP_TIME_MS   1000

LOG_MODULE_REGISTER(Less4_Exer3, LOG_LEVEL_DBG);

void main(void)
{
        int exercise_num = 3;
        uint8_t data[] = {0x00, 0x01, 0x02, 0x03,
                        0x04, 0x05, 0x06, 0x08,
                        'H', 'e', 'l', 'l','o'};

        //Printf-like messages
        LOG_INF("nRF Connect SDK Fundamentals");
        LOG_INF("Exercise %d",exercise_num);    
        LOG_DBG("A log message in debug level");
        LOG_WRN("A log message in warning level!");
        LOG_ERR("A log message in error level!");

        //Hexdump some data
        LOG_HEXDUMP_INF(data, sizeof(data),"Sample Data!"); 


        while (1) {
                k_msleep(SLEEP_TIME_MS); 
                LOG_INF("Loop");
        }
}
```
